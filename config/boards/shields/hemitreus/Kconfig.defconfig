## config/boards/shields/hemitreus/Kconfig.defconfig
```kconfig
if SHIELD_HEMITREUS_LEFT

config ZMK_KEYBOARD_NAME
    default "Hemitreus"

config ZMK_SPLIT_ROLE_CENTRAL
    default y

endif

if SHIELD_HEMITREUS_LEFT || SHIELD_HEMITREUS_RIGHT

config ZMK_SPLIT
    default y

endif
```

## config/boards/shields/hemitreus/Kconfig.shield
```kconfig
config SHIELD_HEMITREUS_LEFT
    def_bool $(shields_list_contains,hemitreus_left)

config SHIELD_HEMITREUS_RIGHT
    def_bool $(shields_list_contains,hemitreus_right)
```
